// SPDX-License-Identifier: GPL-2.0+ OR X11
/*
 * Device Tree file for Arturus Layerscape-1012A family SoC.
 *
 * Copyright 2016-2020, Arcturus Networks, Inc.
 */

/dts-v1/;
#include "arc-ucls1012a.dtsi"

/ {
	chosen {
		stdout-path = &duart0;
	};
};
