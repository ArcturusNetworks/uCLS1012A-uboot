## board/Arcturus/ucls1012a/Kconfig
```kconfig
if TARGET_UCLS1012A

config SYS_BOARD
	default "ucls1012a"

config SYS_VENDOR
	default "Arcturus"

config SYS_SOC
	default "fsl-layerscape"

config SYS_CONFIG_NAME
	default "UCLS1012A"

choice
	prompt "SubTarget image select"

config SUBTARGET_SOM
	bool "Base UCLS1012A-SOM image"

config SUBTARGET_SOM120
	bool "Base UCLS1012A-SOM120 image"

config SUBTARGET_SOM314
	bool "314 SOM Host"

config SUBTARGET_DONGLE
	bool "UCLS1012A-SOM image for Programming Dongle"

endchoice

config SPI_FLASH_128M
	bool "128MBytes QSPI"
	def_bool y

config HX3_HUB_INIT
	bool "Init HX3 USB HUB"
	def_bool y

config FIRM_ADDR1
	hex "Firmware Env Base address 1"
	default 0x1C0000

config FIRM_ADDR2
	hex "Firmware Env Base address 2"
	default 0x1D0000

config BOARD_REVISION_BASE
	hex "Board Revision Base address"
	default 0x4000002C

config SYS_LS_PFE_FW_ADDR
	hex "Flash address of PFE firmware"
	default 0x40020000

config SYS_LS_PFE_FW_LENGTH
	hex "length of PFE firmware"
	default 0x40000

config SYS_LS_PPA_FW_ADDR
	hex "PPA Firmware Addr"
	default 0x40060000

config SYS_LS_PPA_ESBC_ADDR
	hex "PPA Firmware HDR Addr"
	default 0x401f4000

config SYS_LS_PFE_ESBC_ADDR
	hex "PFE Firmware HDR Addr"
	default 0x401f8000

config SYS_LS_PFE_ESBC_LENGTH
	hex "length of PFE Firmware HDR"
	default 0xc00

config BOARD_SPECIFIC_OPTIONS # dummy
	def_bool y
	select PHYLIB
	imply PHY_ATHEROS

config DDR_PFE_PHYS_BASEADDR
	hex "PFE DDR physical base address"
	default 0x03800000

config DDR_PFE_BASEADDR
	hex "PFE DDR base address"
	default 0x83800000

config PFE_EMAC1_PHY_ADDR
	hex "EMAC1 phy address"
	default 0x4

config PFE_EMAC2_PHY_ADDR
	hex "EMAC2 phy address"
	default 0x5

source "board/freescale/common/Kconfig"

endif
```

## configs/UCLS1012A-SOM_QSPI128_defconfig
```kconfig
CONFIG_ARM=y
CONFIG_TARGET_UCLS1012A=y
CONFIG_SUBTARGET_SOM=y
CONFIG_SYS_EXTRA_OPTIONS="QSPI_BOOT"
# CONFIG_CMD_IMLS is not set
# CONFIG_FSL_LS_PPA is not set
CONFIG_SYS_NS16550=y
CONFIG_DEFAULT_DEVICE_TREE="arc-ucls1012a"
CONFIG_OF_CONTROL=y
CONFIG_DM=y
CONFIG_SPI_FLASH=y
CONFIG_SPI_FLASH_128M=y
# CONFIG_SPI_FLASH_USE_4K_SECTORS is not set
CONFIG_SPI_FLASH_NOBAR=y
CONFIG_DM_SPI=y
CONFIG_FIRM_ADDR1=0x40000
CONFIG_FIRM_ADDR2=0x40800
CONFIG_SYS_PROMPT="B$ "
CONFIG_AUTOBOOT_KEYED=y
CONFIG_AUTOBOOT_PROMPT="Autobooting in %d seconds, press \"<Esc>\" to stop\n"
CONFIG_AUTOBOOT_STOP_STR="\x1b"
```

## configs/UCLS1012A_SOM120_defconfig
```kconfig
CONFIG_ARM=y
CONFIG_TARGET_UCLS1012A=y
CONFIG_SYS_TEXT_BASE=0x40100000
CONFIG_NR_DRAM_BANKS=2
CONFIG_ENV_SIZE=0x40000
CONFIG_ENV_OFFSET=0x200000
CONFIG_ENV_SECT_SIZE=0x10000
CONFIG_DM_GPIO=y
CONFIG_FSL_LS_PPA=y
CONFIG_PFE_EMAC1_PHY_ADDR=4
CONFIG_PFE_EMAC2_PHY_ADDR=6
CONFIG_SUBTARGET_SOM120=y
CONFIG_DEFAULT_DEVICE_TREE="arc-ucls1012a-som-common"
CONFIG_AHCI=y
CONFIG_DISTRO_DEFAULTS=y
# CONFIG_SYS_MALLOC_F is not set
CONFIG_FIT_VERBOSE=y
CONFIG_OF_BOARD_SETUP=y
CONFIG_OF_STDOUT_VIA_ALIAS=y
CONFIG_SYS_EXTRA_OPTIONS="QSPI_BOOT"
CONFIG_QSPI_BOOT=y
CONFIG_BOOTDELAY=3
CONFIG_AUTOBOOT_KEYED=y
CONFIG_AUTOBOOT_PROMPT="Autobooting in %d seconds, press \"<Esc>\" to stop\n"
CONFIG_AUTOBOOT_STOP_STR="\x1b"
# CONFIG_DISPLAY_BOARDINFO is not set
CONFIG_DISPLAY_BOARDINFO_LATE=y
CONFIG_LAST_STAGE_INIT=y
CONFIG_SYS_PROMPT="B$ "
CONFIG_CMD_GREPENV=y
CONFIG_CMD_GPIO=y
CONFIG_CMD_GPT=y
CONFIG_CMD_I2C=y
CONFIG_CMD_MMC=y
CONFIG_CMD_USB=y
# CONFIG_CMD_SETEXPR is not set
CONFIG_CMD_CACHE=y
CONFIG_CMD_CRAMFS=y
CONFIG_OF_CONTROL=y
CONFIG_ENV_OVERWRITE=y
CONFIG_ENV_IS_IN_SPI_FLASH=y
CONFIG_ENV_ADDR=0x40200000
CONFIG_SYS_RELOC_GD_ENV_ADDR=y
CONFIG_NET_RANDOM_ETHADDR=y
CONFIG_DM=y
CONFIG_DM_PCA953X=y
CONFIG_MPC8XXX_GPIO=y
CONFIG_DM_I2C=y
CONFIG_DM_MMC=y
CONFIG_FSL_ESDHC=y
CONFIG_DM_SPI_FLASH=y
# CONFIG_SPI_FLASH_BAR is not set
CONFIG_SPI_FLASH_SPANSION=y
CONFIG_SPI_FLASH_STMICRO=y
# CONFIG_SPI_FLASH_USE_4K_SECTORS is not set
CONFIG_FSL_PFE=y
CONFIG_DM_ETH=y
CONFIG_DM_SCSI=y
CONFIG_SYS_NS16550=y
CONFIG_SPI=y
CONFIG_DM_SPI=y
CONFIG_FSL_QSPI=y
CONFIG_USB=y
CONFIG_DM_USB=y
CONFIG_USB_XHCI_HCD=y
CONFIG_USB_XHCI_DWC3=y
CONFIG_FS_CRAMFS=y
```

## configs/ls1012afrdm_qspi_defconfig
```kconfig
CONFIG_ARM=y
CONFIG_TARGET_LS1012AFRDM=y
CONFIG_SYS_EXTRA_OPTIONS="QSPI_BOOT, FSL_LS_PPA"
# CONFIG_CMD_IMLS is not set
CONFIG_SYS_NS16550=y
CONFIG_DEFAULT_DEVICE_TREE="fsl-ls1012a-frdm"
CONFIG_OF_CONTROL=y
CONFIG_DM=y
CONFIG_SPI_FLASH=y
CONFIG_DM_SPI=y
```
